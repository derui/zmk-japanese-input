#include "../behavior_keymap.dtsi"

&kscan {
    events = <
        // enabled
        ZMK_MOCK_PRESS(0,3,10)
        ZMK_MOCK_RELEASE(0,3,10)
        
        ZMK_MOCK_PRESS(0,0,10)
        ZMK_MOCK_RELEASE(0,0,10)
        ZMK_MOCK_PRESS(0,1,10)
        ZMK_MOCK_RELEASE(0,1,10)

        // シフト面の確認
        ZMK_MOCK_PRESS(0,0,10)
        ZMK_MOCK_PRESS(0,1,10)
        ZMK_MOCK_RELEASE(0,0,10)
        ZMK_MOCK_RELEASE(0,1,10)
    >;
};
