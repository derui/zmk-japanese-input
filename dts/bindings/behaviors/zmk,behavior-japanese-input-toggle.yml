## dts/bindings/behaviors/zmk,behavior-japanese-input-toggle.yml
```yaml
# Copyright (c) 2020-2025 The ZMK Contributors
# SPDX-License-Identifier: MIT

description: Enable/Disable Original japanese input behaviors

compatible: "zmk,behavior-japanese-input-toggle"

# a parameter is integer, <1> is enabled, <0> is disabled
include: one_param.yaml
```

## dts/bindings/behaviors/zmk,behavior-japanese-input.yml
```yaml
# Copyright (c) 2020-2025 The ZMK Contributors
# SPDX-License-Identifier: MIT

description: Original japanese input behaviors

compatible: "zmk,behavior-japanese-input"

# first param is key when enabled, second param is fallback key when disabled
include: two_param.yaml
```
